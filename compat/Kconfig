## compat/Kconfig
```kconfig
menu "Compat"
source "compat/cmsis/Kconfig"
source "compat/posix/Kconfig"
endmenu
```

## components/connectivity/agent_tiny/Kconfig
```kconfig
config LOSCFG_COMPONENTS_CONNECTIVITY_ATINY_MQTT
    bool "Enable Agenttiny Mqtt"
    depends on LOSCFG_COMPONENTS_CONNECTIVITY
    select LOSCFG_COMPONENTS_CONNECTIVITY_AGENTTINY
    select LOSCFG_COMPONENTS_CONNECTIVITY_MQTT
    default n
    help
      Answer y to enable angettiny mqtt.

config LOSCFG_COMPONENTS_CONNECTIVITY_AGENTTINY
    bool
```

## components/connectivity/lwm2m/Kconfig
```kconfig
config LOSCFG_COMPONENTS_CONNECTIVITY_LWIP
    bool "Enable Lwip"
    depends on LOSCFG_COMPONENTS_CONNECTIVITY
    default n
    help
        Answer y to enable lwip.
```

## components/connectivity/nb_iot/Kconfig
```kconfig
config LOSCFG_COMPONENTS_CONNECTIVITY_NB_IOT
    bool
    select LOSCFG_COMPONENTS_CONNECTIVITY
```

## components/gui/Kconfig
```kconfig
menu "Graphical User Interface"

config LOSCFG_COMPONENTS_GUI
    bool "Enable Gui"
    default n
    depends on LOSCFG_PLATFORM_STM32F769IDISCOVERY || LOSCFG_PLATFORM_STM32F767_FIRE
    help
      Answer y to enable Graphical User Interface.

endmenu
```

## components/language/Kconfig
```kconfig
menu "Language"

source "components/language/jerryscript/Kconfig"
source "components/language/lua/Kconfig"

endmenu
```

## components/language/jerryscript/Kconfig
```kconfig
config LOSCFG_COMPONENTS_JERRYSCRIPT
    bool "Enable Jerryscript"
    select LOSCFG_COMPONENTS_FS_VFS
    default n
    help
      Answer y to enable Jerryscript.
```

## components/media/Kconfig
```kconfig
menu "Media"

source "components/media/libpng/Kconfig"
source "components/media/openexif/Kconfig"
source "components/media/opus/Kconfig"
source "components/media/upnp/Kconfig"

endmenu
```

## components/net/Kconfig
```kconfig
menu "Network"

config LOSCFG_COMPONENTS_NET_AT
    bool "Enable AT"
    select LOSCFG_COMPONENTS_NETWORK
    default n
    help
        Answer y to enable AT.

choice
    prompt "Choose AT Device"
    default LOSCFG_COMPONENTS_NET_AT_BC95
    depends on LOSCFG_COMPONENTS_NET_AT

    config LOSCFG_COMPONENTS_NET_AT_ESP8266
    bool "Enable esp8266"

    config LOSCFG_COMPONENTS_NET_AT_BC95
    bool "Enable bc95"
    select LOSCFG_COMPONENTS_CONNECTIVITY_NB_IOT

    config LOSCFG_COMPONENTS_NET_AT_SIM900A
    bool "Enable sim900a"

    config LOSCFG_COMPONENTS_NET_AT_BG36
    bool "Enable bg36"

endchoice

config LOSCFG_COMPONENTS_NET_AT_INFO
    bool "Enable AT INFO"
    depends on LOSCFG_COMPONENTS_NET_AT
    default y

config LOSCFG_COMPONENTS_NET_AT_DEBUG
    bool "Enable AT DEBUG"
    depends on LOSCFG_COMPONENTS_NET_AT
    default y

config LOSCFG_COMPONENTS_NET_LWIP
    bool "Enable Lwip"
    select LOSCFG_COMPONENTS_NETWORK
    select LOSCFG_COMPONENTS_FS_VFS
    default n
    help
      Answer y to enable lwip.

config LOSCFG_COMPONENTS_LWIP_DHCP
    bool "Enable DHCP"
    depends on LOSCFG_COMPONENTS_NET_LWIP
    default y
    help
      Answer y to enable lwip dhcp.

choice
    prompt "Enable Ipv4 Or Ipv6"
    default LOSCFG_LWIP_IPV4
    depends on LOSCFG_COMPONENTS_NET_LWIP

config LOSCFG_LWIP_IPV4
    bool "Enable Ipv4"

config LOSCFG_LWIP_IPV6
    bool "Enable Ipv6"

endchoice

config LOSCFG_COMPONENTS_NET_SAL
    bool "Enable Sal"
    select LOSCFG_COMPONENTS_NETWORK
    default n
    help
      Answer y to enable sal.

config LOSCFG_COMPONENTS_NETWORK
    bool

osource "components/net/ifconfig/Kconfig"
osource "components/net/los_iperf/Kconfig"
osource "components/net/pcap/Kconfig"
osource "components/net/ping/Kconfig"
osource "components/net/tftp_server/Kconfig"
osource "components/net/librws/Kconfig"
osource "components/net/http_parser/Kconfig"

endmenu
```

## components/security/Kconfig
```kconfig
menu "Security"

config LOSCFG_COMPONENTS_SECURITY
    bool "Enable Security"
    default n
    help
      Answer Y to enable LiteOS support security

config SECURITY_VERSION
  string
  default "mbedtls-2.6.0"  if LOSCFG_COMPONENTS_SECURITY_VERSION_2_6_0

choice
  prompt "Versio"
  default LOSCFG_COMPONENTS_SECURITY_VERSION_2_6_0
  depends on LOSCFG_COMPONENTS_SECURITY

config LOSCFG_COMPONENTS_SECURITY_VERSION_2_6_0
  bool "mbedtls-2.6.0"
  depends on LOSCFG_COMPONENTS_SECURITY

endchoice


config LOSCFG_COMPONENTS_SECURITY_PORT
  bool "Enable Mbedtls Port"
  default y
  depends on LOSCFG_COMPONENTS_SECURITY

endmenu
```

## components/utility/Kconfig
```kconfig
menu "Utility"

source "components/utility/bidireference/Kconfig"
source "components/utility/c-algorithms/Kconfig"
source "components/utility/curl/Kconfig"
source "components/utility/fastlz/Kconfig"
source "components/utility/freetype/Kconfig"
source "components/utility/harfbuzz/Kconfig"
source "components/utility/iconv/Kconfig"
source "components/utility/inih/Kconfig"
source "components/utility/iniparser/Kconfig"
source "components/utility/json-c/Kconfig"
source "components/utility/jsoncpp/Kconfig"
source "components/utility/libxml2/Kconfig"
source "components/utility/pdfgen/Kconfig"
source "components/utility/sqlite/Kconfig"
source "components/utility/thttpd/Kconfig"
source "components/utility/tinyxml2/Kconfig"
source "components/utility/sfud/Kconfig"
source "components/utility/uriparser/Kconfig"

endmenu
```

## components/utility/c-algorithms/Kconfig
```kconfig
config LOSCFG_COMPONENTS_C_ALGORITHMS
    bool "Enable c-algorithms"
    default n
    help
      Answer y to enable c-algorithms.
```

## components/utility/uriparser/Kconfig
```kconfig
config LOSCFG_COMPONENTS_URIPARSER
    bool "Enable Uriparser"
    default n
    help
      Answer y to enable uriparser.
```

## demos/Kconfig
```kconfig
menu "Demos"

source "demos/dtls_server/Kconfig"
source "demos/agenttiny_mqtt/Kconfig"
source "demos/agenttiny_lwm2m/Kconfig"
source "demos/fs/Kconfig"
source "demos/gui/Kconfig"
source "demos/sensorhub/Kconfig"
source "demos/kernel/Kconfig"
source "demos/nbiot_without_atiny/Kconfig"
source "demos/lms/Kconfig"

endmenu
```

## demos/agenttiny_lwm2m/Kconfig
```kconfig
menu "Agent Tiny Lwm2m Demo"

config LOSCFG_DEMOS_AGENT_TINY_LWM2M
    bool "Enable Agent Tiny Lwm2m Demo"
    select LOSCFG_COMPONENTS_CONNECTIVITY
    select LOSCFG_COMPONENTS_CONNECTIVITY_ATINY_LWM2M
    default n
    help
      Answer y to enable agent tiny lwm2m demo.

endmenu
```

## demos/http_client/Kconfig
```kconfig
menu "Http Client Demo"

config LOSCFG_DEMOS_HTTP_CLIENT
    bool "Enable Http Client Demo"
    select LOSCFG_COMPONENTS_HTTP_PARSER
    default n
    help
      Answer y to enable http client demo.

endmenu
```

## demos/media/Kconfig
```kconfig
menu "Media Demo"

source "demos/media/libpng/Kconfig"
source "demos/media/openexif/Kconfig"
source "demos/media/opus/Kconfig"
source "demos/media/upnp/Kconfig"

endmenu
```

## demos/nbiot_without_atiny/Kconfig
```kconfig
menu "NBIOT Demo Without Atiny"

config LOSCFG_DEMOS_NBIOT_WITHOUT_ATINY
    bool "Enable NBIOT Demo"
    select LOSCFG_COMPONNETS_NET_AT
    select LOSCFG_COMPONENTS_NET_AT_BC95
    default n
    help
        Answer y to enable nbiot demo without atiny.

config LOSCFG_DEMOS_NBIOT_DTLS
    bool "Enable NBIOT Demo With Dtls"
    default n
    depends on LOSCFG_DEMOS_NBIOT_WITHOUT_ATINY
    help
        Answer y to enable nbiot demo with dtls.

endmenu
```

## demos/perf/Kconfig
```kconfig
menu "PERF Demo"

config LOSCFG_DEMOS_PERF
    bool "Enable PERF Demo"
    default n
    depends on LOSCFG_KERNEL_PERF
    help
      Answer y to enable perf demo.

endmenu
```

## demos/security/Kconfig
```kconfig
menu "Security Demo"

source "demos/security/openssl/Kconfig"
source "demos/security/rhash/Kconfig"

endmenu
```

## demos/utility/Kconfig
```kconfig
menu "Utility Demo"

source "demos/utility/bidireference/Kconfig"
source "demos/utility/fastlz/Kconfig"
source "demos/utility/freetype/Kconfig"
source "demos/utility/iconv/Kconfig"
source "demos/utility/iniparser/Kconfig"
source "demos/utility/json-c/Kconfig"
source "demos/utility/jsoncpp/Kconfig"
source "demos/utility/libxml2/Kconfig"
source "demos/utility/sqlite/Kconfig"

endmenu
```

## demos/utility/c-algorithms/Kconfig
```kconfig
config LOSCFG_DEMOS_C_ALGORITHMS
    bool "Enable c-algorithms Demo"
    select LOSCFG_COMPONENTS_C_ALGORITHMS
    default n
    help
      Answer y to enable algorithms demo.
```

## kernel/Kconfig
```kconfig
menu "Kernel"
config LOSCFG_KERNEL_LITEKERNEL
    bool "Enable Lite Kernel"
    default y
    help
      This option will enable lite kernel of LiteOS. This is a basic feature,
      so you should say Y here.

choice
    prompt "Mem Type"
    default LOSCFG_KERNEL_MEM_BESTFIT
    depends on  LOSCFG_KERNEL_LITEKERNEL

config LOSCFG_KERNEL_MEM_BESTFIT
    bool "Enable mem bestfit"
    help
      This option will change mem type as bestfit

config LOSCFG_KERNEL_MEM_BESTFIT_LITTLE
    bool "Enable mem bestfit_little"
    help
      This option will change mem type as bestfit little
endchoice

config LOSCFG_KERNEL_EXTKERNEL
    bool "Enable Extend Kernel"
    default y
    depends on LOSCFG_KERNEL_LITEKERNEL
    help
      This option will enable extend Kernel of LiteOS.  Extend kernel include
      cppsupport, cpup, dynload, runstop and scatter. You can select one or some
      of them.

config LOSCFG_KERNEL_CPPSUPPORT
    bool "C++ Support"
    default y
    depends on LOSCFG_KERNEL_EXTKERNEL
    help
      If you wish to build LiteOS with support for C++.

config LOSCFG_KERNEL_MPU
   bool "Enable MPU Support"
   default n
   depends on LOSCFG_KERNEL_EXTKERNEL
   help
     Enable this option only when the processor has a Memory Protection Unit

config LOSCFG_KERNEL_CPUP
    bool "Enable Cpup"
    default y
    depends on LOSCFG_KERNEL_EXTKERNEL
    help
      If you wish to build LiteOS with support for cpup.

config LOSCFG_CPUP_INCLUDE_IRQ
    bool "Enable Cpup include irq"
    default y
    depends on LOSCFG_KERNEL_CPUP
    help
      If you wish to include irq usage for cpup.

config LOSCFG_KERNEL_DYNLOAD
    bool "Enable Dynamic Load Feature"
    default y
    depends on LOSCFG_KERNEL_EXTKERNEL
    help
      If you wish to build LiteOS with support for dynamic load.

config LOSCFG_KERNEL_RUNSTOP
    bool "Enable Run stop Feature"
    default y
    depends on LOSCFG_KERNEL_EXTKERNEL && (LOSCFG_DRIVERS_MTD_NAND || LOSCFG_DRIVERS_MTD_SPI_NOR)
    help
      If you wish to build LiteOS with support for run-stop.

config LOSCFG_KERNEL_SCATTER
    bool "Enable Scatter Feature"
    default y
    depends on LOSCFG_KERNEL_EXTKERNEL && (LOSCFG_DRIVERS_MTD_NAND || LOSCFG_DRIVERS_MTD_SPI_NOR)
    help
      If you wish to build LiteOS with support for scatter.

config LOSCFG_KERNEL_TICKLESS
    bool "Enable Tickless Feature"
    default y
    depends on LOSCFG_KERNEL_EXTKERNEL
    help
      If you wish to build LiteOS with support for tickless.

config LOSCFG_KERNEL_TRACE
    bool "Enable Trace Feature"
    default n
    depends on LOSCFG_KERNEL_EXTKERNEL
    help
      If you wish to record LiteOS's task and interrupt switch trace.

config LOSCFG_KERNEL_SMP
    bool "Enable Kernel SMP"
    default n
    help
      This option will enable smp support of LiteOS.

config LOSCFG_KERNEL_SMP_CORE_NUM
    int "Muti-processing Core Numbers"
    default 2
    depends on LOSCFG_KERNEL_SMP
    help
      This represents the number of muti-processing cores.

config LOSCFG_KERNEL_SMP_LOCKDEP
    bool "Enable Spinlock Lockdep Check"
    default n
    depends on LOSCFG_KERNEL_SMP
    help
      This option will enable spinlock lockdep check.

config LOSCFG_KERNEL_SMP_TASK_SYNC
    bool "Enable Synchronized Task Operations"
    default n
    depends on LOSCFG_KERNEL_SMP
    help
      This option will enable task synchronized operate task across cores.

config LOSCFG_KERNEL_SCHED_STATISTICS
    bool "Enable Scheduler statistics"
    default n
    depends on LOSCFG_KERNEL_SMP
    help
      This option will enable schedulder statistics.

choice
    prompt "Scheduler"
    default LOSCFG_SCHED_SQ
    help
      The scheduler used to dispacher tasks.
config LOSCFG_SCHED_SQ
    bool "Single Ready Queue"
config LOSCFG_SCHED_MQ
    bool "Mutiple Ready Queue"

endchoice

endmenu
```

## lib/Kconfig
```kconfig
menu "Lib"
choice
    prompt "Enable Libc"
    default LOSCFG_LIB_LIBC
    help
      Enable full libc for full code.
      Disable libc

config LOSCFG_LIB_LIBC
    bool "Enable Full Libc"

config LOSCFG_NO_LIBC
    bool "Disable Libc"
endchoice

config LOSCFG_LIB_LIBM
    bool "Enable Libm"
    default y
    depends on  LOSCFG_LIB_LIBC
    help
      Answer Y to enable LiteOS support math library.

config LOSCFG_LIB_ZLIB
    bool "Enable Zlib"
    default y
    depends on LOSCFG_LIB_LIBC && LOSCFG_LIB_LIBM
    help
      Answer Y to enable LiteOS support compress file library.
endmenu
```
