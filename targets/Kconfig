## targets/Kconfig
```kconfig
choice
    prompt "Family"

config LOSCFG_FAMILY_STM32
    bool "STM32"

config LOSCFG_FAMILY_QEMU
    bool "QEMU"

endchoice


osource "targets/Kconfig.stm32"
osource "targets/Kconfig.qemu"

config LOSCFG_HW_SD_CARD
    bool

config LOSCFG_DRIVER_HAL_LIB
    bool

config LOSCFG_DRIVER_GD_LIB
    bool

config LOSCFG_DRIVER_CSKY_LIB
    bool

config LOSCFG_DRIVER_SIFIVE_LIB
    bool

config LOSCFG_HW_SPI_FLASH
    bool

config LOSCFG_USING_BOARD_LD
    bool
```

## targets/Kconfig.apm32
```kconfig
config LOSCFG_PLATFORM
    string
    default "APM32F103_APEXMIC"           	if LOSCFG_PLATFORM_APM32F103_APEXMIC

choice
    prompt "Board"
    depends on LOSCFG_FAMILY_APM32
    default LOSCFG_PLATFORM_APM32F103_APEXMIC
    help
      support several boards:
      APM32F103_APEXMIC

config LOSCFG_PLATFORM_APM32F103_APEXMIC
    bool "APM32F103_APEXMIC"
    select LOSCFG_USING_BOARD_LD
    select LOSCFG_ARCH_CORTEX_M3
    select LOSCFG_CORTEX_M_NVIC
    select LOSCFG_CORTEX_M_SYSTICK
    select LOSCFG_DRIVER_APM_LIB

endchoice
```

## targets/Kconfig.gd
```kconfig
config LOSCFG_PLATFORM
    string
    default "GD32VF103V_EVAL"       if LOSCFG_PLATFORM_GD32VF103V_EVAL

choice
    prompt "Board"
    depends on LOSCFG_FAMILY_GD
    default LOSCFG_PLATFORM_GD32VF103V_EVAL
    help
      GD32VF103V_EVAL


config LOSCFG_PLATFORM_GD32VF103V_EVAL
    bool "GD32VF103V_EVAL"
    select LOSCFG_USING_BOARD_LD
    select LOSCFG_ARCH_RISCV_RV32IMC
    select LOSCFG_RISCV32_M_TIMER
    select LOSCFG_PLATFORM_BSP_RISCV_ECLIC
    select LOSCFG_DRIVER_GD_LIB

endchoice
```

## targets/Kconfig.qemu
```kconfig
config LOSCFG_PLATFORM
    string
    default "realview-pbx-a9" if LOSCFG_PLATFORM_PBX_A9
    default "qemu-virt-a53"   if LOSCFG_PLATFORM_QEMU_VIRT_A53

choice
    prompt "Board"
    depends on LOSCFG_FAMILY_QEMU
    default LOSCFG_PLATFORM_PBX_A9
    help
      qemu-virt-a53
      realview-pbx-a9

config LOSCFG_PLATFORM_PBX_A9
    bool "realview-pbx-a9"
    select LOSCFG_ARCH_CORTEX_A9
    select LOSCFG_ARM_GIC_V2
    select LOSCFG_ARM_PRIVATE_TIMER
    select LOSCFG_DRIVERS_UART_ARM_PL011
    select LOSCFG_USING_BOARD_LD

config LOSCFG_PLATFORM_QEMU_VIRT_A53
    bool "qemu-virt-a53"
    select LOSCFG_ARCH_CORTEX_A53
    select LOSCFG_ARM_GIC_V2
    select LOSCFG_ARM_GENERIC_TIMER
    select LOSCFG_DRIVERS_UART_ARM_PL011
    select LOSCFG_ARCH_ARM_AARCH64
    select LOSCFG_USING_BOARD_LD

endchoice
```

## targets/Kconfig.raspberry
```kconfig
config LOSCFG_PLATFORM
    string
    default "Raspberry_Pi2B"      if LOSCFG_PLATFORM_RASPBERRY_PI2B
    default "Raspberry32_Pi3B"    if LOSCFG_PLATFORM_RASPBERRY32_PI3B

choice
    prompt "Board"
    depends on LOSCFG_FAMILY_RASPBERRY
    default LOSCFG_PLATFORM_RASPBERRY_PI2B
    help
      Raspberry Pi2B
      Raspberry32 Pi3B

config LOSCFG_PLATFORM_RASPBERRY_PI2B
    bool "Raspberry_Pi2B"
    select LOSCFG_ARCH_CORTEX_A7
    select LOSCFG_USING_BOARD_LD
    select LOSCFG_PLATFORM_ARM_CONTROL
    select LOSCFG_RASPBERRY_PI_SYSTICK

config LOSCFG_PLATFORM_RASPBERRY32_PI3B
    bool "Raspberry32_Pi3B"
    select LOSCFG_ARCH_CORTEX_A53_AARCH32
    select LOSCFG_USING_BOARD_LD
    select LOSCFG_PLATFORM_ARM_CONTROL
    select LOSCFG_RASPBERRY_PI_SYSTICK

endchoice
```

## targets/Kconfig.xtensa
```kconfig
config LOSCFG_PLATFORM
    string
    default "ESP32"      if LOSCFG_PLATFORM_ESP32

choice
    prompt "Board"
    depends on LOSCFG_FAMILY_XTENSA
    default LOSCFG_PLATFORM_ESP32
    help
      ESP32

config LOSCFG_PLATFORM_ESP32
    bool "ESP32"
    select LOSCFG_USING_BOARD_LD
    select LOSCFG_ARCH_XTENSA_LX6
    select LOSCFG_XTENSA_LX6_TIMER
    select LOSCFG_LX6_INT_CONTROLLER

endchoice
```
